/*@!Encoding:1250*/
includes
{
  
}

variables
{
  
}


void MainTest()
{
  EngineSwitchOnState();
  EngineSwitchOffState();
}

testcase EngineSwitchOnState()
{
  if((testWaitForSignalMatch(OnOff, @sysvar::Engine::EngineStateSwitch, 100) == 1) && ($OnOff == 1))
  {
    testStepPass("EngineState", "engine on, values same");
  } else 
  {
    testStepFail("EngineState", "failed");
  }
}

testcase EngineSwitchOffState()
{
  if((testWaitForSignalMatch(OnOff, @sysvar::Engine::EngineStateSwitch, 100) == 1) && ($OnOff == 0))
  {
    testStepPass("EngineState", "engine off, values same");
  } else 
  {
    testStepFail("EngineState", "failed");
  }
}

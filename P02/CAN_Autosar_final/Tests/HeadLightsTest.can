/*@!Encoding:1250*/
includes
{
  
}

variables
{
  float temp = 0;
}

void MainTest()
{
  HeadLightsOn();
  HeadLightsOff();
}

testcase HeadLightsOn()
{
  if($HeadLight== 1)
  {
    temp = 4;
  }
  if ((testWaitForSignalMatch(sysvar::Lights::LightDisplay, temp, 2000) == 1) && ($HeadLight == 1))
  {
    testStepPass("EngineSpeed", "lights on, values same");
  } else 
  {
    testStepFail("EngineSpeed", "failed");
  }
}

testcase HeadLightsOff()
{
  if($HeadLight== 0)
  {
    temp = 0;
  }
  if ((testWaitForSignalMatch(sysvar::Lights::LightDisplay, temp, 2000) == 1) && ($HeadLight == 0))
  {
    testStepPass("EngineSpeed", "lights off, values same");
  } else 
  {
    testStepFail("EngineSpeed", "failed");
  }
}

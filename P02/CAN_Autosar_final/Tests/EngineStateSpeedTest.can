/*@!Encoding:1250*/
includes
{
  
}

variables
{

}

void MainTest()
{
  EngineSpeedState();
}

testcase EngineSpeedState()
{
  
  if (testWaitForSignalMatch(EngineSpeed, @sysvar::Engine::EngineSpeedEntry, 2000) == 1)
  {
    testStepPass("EngineSpeed", "signal and sysvar matched");
  } else 
  {
    testStepFail("EngineSpeed", "speeds are not matched");
  }
}

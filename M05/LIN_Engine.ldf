LIN_description_file;
LIN_protocol_version = "2.2";
LIN_language_version = "2.2";
LIN_speed = 19.2 kbps;

Nodes {
  Master: lin_master, 1 ms, 0 ms ;
  Slaves: lin_slave ;
}

Signals {
  s_ignition_status: 8, 0, lin_master, lin_slave ;
  s_speed: 8, 0, lin_master, lin_slave ;
  s_rpm: 8, 0, lin_master, lin_slave ;
  s_error: 8, 0, lin_master, lin_slave ;
}

Frames {
  engine_speed: 48, lin_master, 8 {
    s_speed, 0 ;
    s_rpm, 8 ;
  }
  engine_ignition: 34, lin_master, 8 {
    s_ignition_status, 0 ;
  }
  engine_status: 38, lin_master, 8 {
    s_ignition_status, 0 ;
  }
  check_engine_status: 39, lin_master, 8 {
    s_error, 0 ;
  }
}

Node_attributes {
  lin_slave{
    LIN_protocol = "2.2" ;
    configured_NAD = 0xFF ;
    initial_NAD = 0xFF ;
    product_id = 0x0, 0x0, 255 ;
    P2_min = 50 ms ;
    ST_min = 0 ms ;
    N_As_timeout = 1000 ms ;
    N_Cr_timeout = 1000 ms ;
    configurable_frames {
      engine_ignition ;
      engine_speed ;
      engine_status ;
      check_engine_status ;
    }
  }
}

Schedule_tables {
 main_table {
    check_engine_status delay 10 ms ;
    engine_status delay 10 ms ;
    engine_speed delay 10 ms ;
  }
 extra_table {
    check_engine_status delay 10 ms ;
    engine_ignition delay 10 ms ;
  }
}

/*@!Encoding:1252*/
variables
{
  int seatSensorActivated = 0;
  int counter = 0;
}

on preStart{
  linStopScheduler();
}

on message CarLockingSystem
{
  $GW_Ignition::LockingSystem = $LockingSystem::ActualState;
  if(this.ActualState == 1)
  {
    linStartScheduler();
  } else {
    linStopScheduler();
  }
}

on message Ignition
{
  $GW_Ignition::PowerOn = $Ignition::PowerOn;
}

on sysvar LIN::Seatheating
{
  if($Ignition::PowerOn == 1 && seatSensorActivated == 1)
  {
    $Heating = @this;   
  } else if($Ignition::PowerOn == 0)
  {
    write("First start car, heating not working!");
    $Heating = 0;
  }
}

on sysvar LIN::SeatSensor
{
  if($Ignition::PowerOn == 1)
  {
    $Seatsensor = @this;
    seatSensorActivated = @this;
    $Heating = @LIN::Seatheating;
  } else if($Ignition::PowerOn == 0 && @this ==1)
  {
    write("First start car, seat sensor not working!");
    $Seatsensor = 0;
    $Heating = 0;
  }
}

on linFrame Seatsensor
{
  if(this.Seatsensor == 1)
  {
    @LIN::SeatSensor_Dsp = 1;
  } else
  {
    $Heating = 0;
    @LIN::SeatSensor_Dsp = 0;
  }
}

on linFrame GW_Ignition
{
  if(this.PowerOn == 0)
  {
    @LIN::Seatheating = 0;
    @LIN::SeatSensor = 0;
  }
}

on sysvar LIN::Seat_up
{
  $Seatsetting::Seat_up = @this;
}

on sysvar LIN::Seat_down
{
  $Seatsetting::Seat_down = @this;
}

on sysvar LIN::Seat_back
{
  $Seatsetting::Seat_back = @this;
}

on sysvar LIN::Seat_forward
{
  $Seatsetting::Seat_forward = @this;
}

on sysvar LIN::Seatback_back
{
  $Seatsetting::Seatback_back = @this;
}

on sysvar LIN::Seatback_forward
{
  $Seatsetting::Seatback_forward = @this;
}

on sysvar LIN::Head_up
{
  $Seatsetting::Head_up = @this;
}

on sysvar LIN::Head_down
{
  $Seatsetting::Head_down = @this;
}

on message Driver_ID
{ 
  if(counter == 0)
  {
    $Seatposition::Driver = $Driver_ID::Driver;
    counter++;
  } else if(counter == 1)
  {
    $Driver_ID::StoreSeatposition = 1;
    counter = 0;
  }
  $StoreSeatposition::Storeposition = $Driver_ID::StoreSeatposition; 
}

on linFrame StoreSeatposition
{
  if(this.Storeposition == 1)
  {
    $Driver_ID::StoreSeatposition = 0;
  }
}
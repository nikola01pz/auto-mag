/*@!Encoding:1252*/
variables
{
  //declare LIN frame
  linFrame Seatsensor msgSeatsensor;
  int carUnlocked = 0;
  int ignitionStatus = 0;
}

on sysvar LIN::SeatSensor
{
  msgSeatsensor.Seatsensor = @this;
  output(msgSeatsensor);
}
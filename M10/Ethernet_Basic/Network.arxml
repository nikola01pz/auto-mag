AUTOSAR XML (schema 4-2-2)
package /Vector
  ethernet cluster Vehicle_Ethernet: baudrate=100000000, protocol-name=ETHERNET, speed=100
    ethernet physical channel adas_channel: comm-connectors=[adas_adas_connector, camf_adas_connector, Connector_ECU1_4cf9cc795f85d190]
      frame Frame1: from ECU1, to CAMF ADAS, frame-length=8
        pdu PDU1: length=2
          signal Signal1: start 0, 1 bit, little-endian, system signal Signal1_e744eb018b81d704, data-type-policy=OVERRIDE, base-type=A_UINT16, to CAMF ADAS
          signal Signal2: start 8, 2 bit, little-endian, system signal Signal2_13904b2da6ad732d, data-type-policy=OVERRIDE, base-type=A_UINT16, to CAMF ADAS
        carries pdu PDU2: packing-byte-order=little-endian, start-position=16
        general purpose pdu PDU2: length=1
        carries pdu PDU3: packing-byte-order=little-endian, start-position=24
        container i pdu PDU3: length=1, container-timeout=0, container-trigger=DEFAULT-TRIGGER, header-type=LONG-HEADER, rx-accept-contained-i-pdu=ACCEPT-CONFIGURED, threshold-size=0
        carries pdu PDU4: packing-byte-order=little-endian, start-position=32
        pdu PDU4: length=2
          signal Signal3: start 0, 8 bit, little-endian, system signal Signal3_5e70ae07171dc133, data-type-policy=OVERRIDE, base-type=A_UINT16, to CAMF ADAS
          signal Signal5: start 8, 2 bit, little-endian, system signal Signal5_6cdd81574a2e7156, data-type-policy=OVERRIDE, base-type=A_UINT16, to CAMF ADAS
          signal Signal4: start 10, 1 bit, little-endian, system signal Signal4_acf297226771a036, data-type-policy=OVERRIDE, base-type=A_UINT16, to CAMF ADAS
      pdu triggering pdu_triggering_TrafficSignDetectionPDU: pdu=TrafficSignDetectionPDU, from CAMF, to ADAS
      network endpoint adas_adas_nep: network-endpoint-addresses=ipv-4-configuration={ipv-4-address=192.168.3.4, ipv-4-address-source=FIXED, network-mask=255.255.255.0}
      network endpoint camf_adas_nep: network-endpoint-addresses=ipv-4-configuration={ipv-4-address=192.168.3.6, ipv-4-address-source=FIXED, network-mask=255.255.255.0}
      so-ad-config:
        socket connection bundle ID3: socket-connection=socket_address_adas_adas_aep, pdus=socket-connection-ipdu-identifier={header-id=131137636, pdu-triggering=pdu_triggering_TrafficSignDetectionPDU, routing-group=adas_adas_display_info_ceg}, server-port=socket_address_camf_adas_aep
        socket address socket_address_adas_adas_aep: connector=adas_adas_connector
          application endpoint adas_adas_aep: network-endpoint=adas_adas_nep, tp-configuration=udp-tp=udp-tp-port=port-number=30500
            consumed service instance adas_adas_display_info_csi: provided-service-instance=ADASDisplayInfo, sd-client-config={client-service-major-version=1, client-service-minor-version=0, initial-find-behavior={initial-delay-max-value=0.05, initial-delay-min-value=0.05, initial-repetitions-base-delay=0.1, initial-repetitions-max=3}, ttl=3}
              consumed event group adas_adas_display_info_ceg: application-endpoint=adas_adas_aep, event-group-identifier=1, routing-group=adas_adas_display_info_ceg
        socket address socket_address_camf_adas_aep: connector=camf_adas_connector
          application endpoint camf_adas_aep: network-endpoint=camf_adas_nep, tp-configuration=udp-tp=udp-tp-port=port-number=30500
            provided service instance ADASDisplayInfo: instance-identifier=1, sd-server-config={initial-offer-behavior={initial-delay-max-value=0.05, initial-delay-min-value=0.05, initial-repetitions-base-delay=0.1, initial-repetitions-max=3}, offer-cyclic-delay=2, server-service-major-version=1, server-service-minor-version=0, ttl=3}, service-identifier=2001
              event handler ADASDisplayInfo_eh: application-endpoint=camf_adas_aep, consumed-event-group=adas_adas_display_info_ceg
      vlan VLAN_ADAS: vlan-identifier=3
package /Vector/ECUs
  ecu instance ADAS: associated-com-i-pdu-group=[PduGroup_955dbd4975c0465a895ed4df23deb8e9_Rx, PduGroup_63785361f2144506b8d31587684c4f85_Rx]
    ethernet communication controller adas_controller: mac-unicast-address=20:00:00:00:01:04
    ethernet communication connector adas_adas_connector: comm-controller=adas_controller, network-endpoint=adas_adas_nep
  ecu instance CAMF: associated-com-i-pdu-group=[PduGroup_2a4234ddd32548e1a9d1c8752f638cd7_Rx, PduGroup_53ca95c340f4479ba4ecf4b04e704d2a_Rx]
    ethernet communication controller camf_controller: mac-unicast-address=20:00:00:00:01:06
    ethernet communication connector camf_adas_connector: comm-controller=camf_controller, network-endpoint=camf_adas_nep
package /Vector/PDUs
  pdu TrafficSignDetectionPDU: length=18, unused-bit-pattern=0
    signal TrafficSignDetectionSerialized: start 0, little-endian, data-transformations=SOMEIP, someip-transformation-i-signal-props{transformer=someip_transformer, interface-version=1}
package /Vector/CompuMethods
  compu method Temperature: phys=raw*0.1-273.15; unit °C
  compu method Speed: phys=raw*0.1; unit km/h
  compu method Current: phys=raw*0.001-1000; unit A
  compu method Power: phys=raw*0.001-1000; unit kW
  compu method Capacity: phys=raw*0.001; unit kWh
  compu method activate_cm: 0=Deactivate, 1=Activate
  compu method activate_result_cm: 0=Failed, 1=Success
  compu method frame_rate_cm: ; unit fr/sec
package /Vector/Units
  8 x unit:
    degree: display-name=°C
    kmh: display-name=km/h
    meter: display-name=m
    ampere: display-name=A
    kw: display-name=kW
    kwh: display-name=kWh
    detectionReliability_unit: display-name=%
    frsec: display-name=fr/sec
package /Vector/RoutingGroups
  so ad routing group adas_adas_display_info_ceg: event-group-control-type=ACTIVATION-UNICAST
package /Vector/ApplicationDataTypes
  application array data type DetectedTrafficSigns: category=ARRAY
    element DetectedTrafficSign: category=STRUCTURE, type=DetectedTrafficSign, array-size-semantics=FIXED-SIZE, max-number-of-elements=3
  application record data type DetectedTrafficSign: category=STRUCTURE
    application record element signType_dt: category=VALUE, type=signType_dt
    application record element signDistance_dt: category=VALUE, type=signDistance_dt
    application record element detectionReliability_dt: category=VALUE, type=detectionReliability_dt
  app type signType_dt: category=VALUE
  app type signDistance_dt: category=VALUE
  app type detectionReliability_dt: category=VALUE
  application record data type TrafficSignDetection: category=STRUCTURE
    application record element DetectedTrafficSign: category=STRUCTURE, type=DetectedTrafficSigns
package /Vector/ImplementationDataTypes
  6 x impl type:
    DetectedTrafficSigns: category=ARRAY
      element DetectedTrafficSigns: array-size=3, array-size-semantics=FIXED-SIZE, implementation-data-type=DetectedTrafficSign
    DetectedTrafficSign: category=STRUCTURE
      element SignType: implementation-data-type=signType_dt
      element DistanceToSign: implementation-data-type=signDistance_dt
      element Reliability: implementation-data-type=detectionReliability_dt
    signType_dt: category=VALUE, base-type=BaseTypes/A_UINT8, compu {0=NoObject, 1=SpeedLimit30Sign, 2=SpeedLimit50Sign, 3=SpeedLimit60Sign, 4=SpeedLimit70Sign, 5=SpeedLimit80Sign, 6=SpeedLimit100Sign, 7=NoLimit80Sign, 8=NoPassingZoneSign, 9=NoPassingZoneEndSign, 10=HazardSign, 11=HazardEndSign, 12=RoadworkSign, 13=RoadworkEndSign}
    signDistance_dt: category=VALUE, base-type=A_UINT32, compu {phys=raw*0.1-1000000, 0=NoDistance; unit m}
    detectionReliability_dt: category=VALUE, base-type=BaseTypes/A_UINT8, compu {; unit %}
    TrafficSignDetection: category=STRUCTURE
      element DetectedTrafficSign: implementation-data-type=DetectedTrafficSigns
package /Vector/DataTypeMappings
  data type mapping set DATA_TYPE_MAPPING_SET
    data-type-maps:
      application-data-type=TrafficSignDetection, implementation-data-type=TrafficSignDetection
      application-data-type=DetectedTrafficSigns, implementation-data-type=DetectedTrafficSigns
      application-data-type=DetectedTrafficSign, implementation-data-type=DetectedTrafficSign
      application-data-type=signType_dt, implementation-data-type=signType_dt
      application-data-type=signDistance_dt, implementation-data-type=signDistance_dt
      application-data-type=detectionReliability_dt, implementation-data-type=detectionReliability_dt
package /Vector/PortInterfaces
  sender receiver interface SenderReceiver
    data TrafficSignDetection: type=TrafficSignDetection
package /Vector/SystemsMappings
  system System
    system mapping SystemMapping: sender-receiver-to-signal-mapping{data-element=TrafficSignDetection, system-signal=TrafficSignDetectionSerialized}
package /Vector/Transformer
  data transformation set transformation_set
    data transformation SOMEIP: transformer-chain=someip_transformer
    transformation technology someip_transformer: protocol=SOMEIP, someip-transformation-description{alignment=8, byte-order=little-endian, interface-version=1}, transformer-class=SERIALIZER, version=1
package /AUTOSAR/BaseTypes
  4 x base type, all with base-type-encoding=NONE:
    A_UINT8: base-type-size=8
    A_UINT8: base-type-size=8
    A_UINT16: base-type-size=16
    A_UINT32: base-type-size=32
package /VectorAutosarExplorerGeneratedObjects/PDUS
  dcm i pdu New_PDU1: length=8
  dcm i pdu New_PDU2: length=8, diag-pdu-type=DIAG-REQUEST
  dcm i pdu New_PDU3: length=8, diag-pdu-type=DIAG-RESPONSE
  dcm i pdu New_PDU4: length=8
  dcm i pdu New_PDU: length=8
  dcm i pdu New_PDU_1: length=8
  dcm i pdu New_PDU_2: length=8
  dcm i pdu New_PDU10: length=8, diag-pdu-type=DIAG-REQUEST  # FRFDS | EE
  dcm i pdu New_PDU_11: length=8, diag-pdu-type=DIAG-RESPONSE
  n pdu New_Frame_NewPDU: length=16
  general purpose pdu New_Frame_NewPDU_1: length=8
  container i pdu New_Frame_NewPDU_2: length=8, container-timeout=0, container-trigger=DEFAULT-TRIGGER, header-type=LONG-HEADER, rx-accept-contained-i-pdu=ACCEPT-CONFIGURED, threshold-size=0
package /VectorAutosarExplorerGeneratedObjects/ECU_INSTANCES
  ecu instance New_ECU: diagnostic-address=0
  ecu instance ECU1: associated-com-i-pdu-group=[PduGroup_5b005a25d0eb420ca24c77d4f05cecf1_Tx, PduGroup_e4aa028064ee4dd3846bd1728a8e4163_Tx], diagnostic-address=0
    ethernet communication controller Controller_ECU1_28c435cbc1a25fdd
    ethernet communication connector Connector_ECU1_4cf9cc795f85d190: comm-controller=Controller_ECU1_28c435cbc1a25fdd
package /VectorAutosarExplorerGeneratedObjects/FRAME
  ethernet frame New_Frame: frame-length=800
package /VectorAutosarExplorerGeneratedObjects/PDU_GROUP
  6 x i signal i pdu group:
    PduGroup_5b005a25d0eb420ca24c77d4f05cecf1_Tx: communication-direction=OUT
    PduGroup_2a4234ddd32548e1a9d1c8752f638cd7_Rx: communication-direction=IN
    PduGroup_955dbd4975c0465a895ed4df23deb8e9_Rx: communication-direction=IN
    PduGroup_e4aa028064ee4dd3846bd1728a8e4163_Tx: communication-direction=OUT
    PduGroup_53ca95c340f4479ba4ecf4b04e704d2a_Rx: communication-direction=IN
    PduGroup_63785361f2144506b8d31587684c4f85_Rx: communication-direction=IN

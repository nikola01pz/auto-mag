/*@!Encoding:1252*/
variables 
{
}

on sysvar sysvar::Engine::EngineStateSwitch
{
 $EngineState::OnOff = @this;
  if(@this) {

    $EngineState::EngineSpeed = @sysvar::Engine::EngineSpeedEntry;
    //$LightState::FlashLight =  @sysvar::Lights::HazardLightsSwitch;
    $LightState::HeadLight =  @sysvar::Lights::HeadLightsSwitch;
  }
  else
  {
    $EngineState::EngineSpeed = 0;
    $LightState::FlashLight = 0;
    $LightState::HeadLight = 0;
  }
}

on sysvar sysvar::Engine::EngineSpeedEntry
{
  if(@sysvar::Engine::EngineStateSwitch) 
  {
    $EngineState::EngineSpeed = @this;
  }
}


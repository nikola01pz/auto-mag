// Description: LIN Description file created using Vector's DaVinci Network Designer

// Created: 07 Sep 2007 15:12:10

// Author: Vector Informatik GmbH

// Version: 0.1

LIN_description_file;
LIN_protocol_version = "2.2";
LIN_language_version = "2.2";
LIN_speed = 19.2 kbps;

Nodes {
  Master: lin_master, 10 ms, 0.1 ms ;
  Slaves: lin_slave ;
}

Signals {
  s_rpm: 8, 0, lin_master, lin_slave ;
  s_ignition_status: 8, 0, lin_master, lin_slave ;
  s_speed: 8, 0, lin_master, lin_slave ;
  s_error: 1, 0, lin_slave, lin_master ;
}

Frames {
  engine_ignition: 34, lin_master, 1 {
    s_ignition_status, 0 ;
  }
  engine_speed: 48, lin_master, 2 {
    s_speed, 0 ;
    s_rpm, 8 ;
  }
  engine_status: 38, lin_master, 1 {
    s_ignition_status, 0 ;
  }
  check_engine_status: 39, lin_slave, 1 {
    s_error, 0 ;
  }
}

Node_attributes {
  lin_slave{
    LIN_protocol = "2.2" ;
    configured_NAD = 0x5 ;
    initial_NAD = 0x5 ;
    product_id = 0x1E, 0x2, 1 ;
    response_error = s_error ;
    P2_min = 50 ms ;
    ST_min = 0 ms ;
    N_As_timeout = 1000 ms ;
    N_Cr_timeout = 1000 ms ;
    configurable_frames {
      engine_speed ;
      engine_status ;
      engine_ignition ;
      check_engine_status ;
    }
  }
}

Schedule_tables {
 main_table {
    engine_speed delay 30 ms ;
    engine_status delay 30 ms ;
    check_engine_status delay 30 ms ;
  }
 extra_table {
    engine_ignition delay 10 ms ;
    check_engine_status delay 10 ms ;
  }
}

Signal_encoding_types {
  Sine_Sig_Type {
    physical_value, 0, 255, 1, 0 ;
  }
  StandardPhys_Sig_Type {
    physical_value, 0, 0, 1, 0 ;
  }
  constant_Signal_Sig_Type {
    physical_value, 0, 255, 1, 0 ;
  }
}

Signal_representation {
  Sine_Sig_Type: s_speed ;
  StandardPhys_Sig_Type: s_rpm ;
  constant_Signal_Sig_Type: s_ignition_status ;
}
